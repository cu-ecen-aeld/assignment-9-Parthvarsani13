## base_external/Config.in
```kconfig
menu "Custom Packages"

config BR2_PACKAGE_AESD_ASSIGNMENTS
    bool "aesd-assignments"
    help
      Custom package to include assignment applications in Buildroot.

endmenu
```
